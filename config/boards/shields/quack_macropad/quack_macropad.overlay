/ {
    chosen {
        zmk,kscan = &default_kscan;
        zmk,encoder = &default_encoder;
    };

    default_kscan: kscan {
        compatible = "zmk,kscan-gpio-direct";
        label = "default_kscan";

        input-gpios =
           <&pro_micro 19 (GPIO_ACTIVE_LOW | GPIO_PULL_UP)>,
           <&pro_micro 14 (GPIO_ACTIVE_LOW | GPIO_PULL_UP)>,
           <&pro_micro 4 (GPIO_ACTIVE_LOW | GPIO_PULL_UP)>,
           <&pro_micro 20 (GPIO_ACTIVE_LOW | GPIO_PULL_UP)>,
           <&pro_micro 15 (GPIO_ACTIVE_LOW | GPIO_PULL_UP)>,
           <&pro_micro 10 (GPIO_ACTIVE_LOW | GPIO_PULL_UP)>,
           <&pro_micro 21 (GPIO_ACTIVE_LOW | GPIO_PULL_UP)>,
           <&pro_micro 18 (GPIO_ACTIVE_LOW | GPIO_PULL_UP)>,
           <&pro_micro 16 (GPIO_ACTIVE_LOW | GPIO_PULL_UP)>;
    };

    default_encoder: encoder {
        compatible = "zmk,encoder";
        label = "default_encoder";
        a-gpios = <&pro_micro 5 (GPIO_ACTIVE_LOW | GPIO_PULL_UP)>;
        b-gpios = <&pro_micro 7 (GPIO_ACTIVE_LOW | GPIO_PULL_UP)>;
    };
};

