## config/boards/shields/quack_macropad/Kconfig.defconfig
```kconfig
if SHIELD_QUACK_MACROPAD

config ZMK_KEYBOARD_NAME
    default "Quack Macropad"

endif
```

## config/boards/shields/quack_macropad/Kconfig.shield
```kconfig
config SHIELD_QUACK_MACROPAD
    def_bool $(shields_list_contains, quack_macropad)
```
